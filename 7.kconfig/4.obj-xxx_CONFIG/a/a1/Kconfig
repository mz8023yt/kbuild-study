## Kconfig/2/a/Kconfig
```kconfig
menuconfig MENU_FUNC_A
	bool "MENU_FUNC_A"
	default y

if MENU_FUNC_A

config FUNC_A
    bool "FUNC_A"
    default y

source a/a1/Kconfig

endif
```

## Kconfig/2/b/Kconfig
```kconfig
menuconfig MENU_FUNC_B
	bool "MENU_FUNC_B"
	default y

if MENU_FUNC_B

config FUNC_B
    bool "FUNC_B"
    default y

endif
```
